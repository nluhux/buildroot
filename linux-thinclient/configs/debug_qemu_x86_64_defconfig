## linux-thinclient/configs/debug_qemu_x86_64_defconfig
```kconfig
# Architecture
BR2_x86_64=y

# source code
BR2_KERNEL_MIRROR="https://mirrors.ustc.edu.cn/kernel.org/"

# Filesystem
BR2_TARGET_ROOTFS_EXT2=y
BR2_TARGET_ROOTFS_EXT2_SIZE="4096M"
BR2_TARGET_ROOTFS_EXT2_MKFS_OPTIONS=""

# enable ccache
BR2_CCACHE=y
BR2_CCACHE_DIR="$(TOPDIR)/cache/.buildroot-ccache"
BR2_CCACHE_INITIAL_SETUP="-M 50G"

# toolchain
BR2_TOOLCHAIN_BUILDROOT_GLIBC=y
BR2_PIC_PIE=y
BR2_SSP_STRONG=y
BR2_RELRO_FULL=y
BR2_FORTIFY_SOURCE_2=y
BR2_TOOLCHAIN_BUILDROOT_CXX=y
BR2_GCC_ENABLE_LTO=y

# DEBUG
BR2_PACKAGE_HOST_GDB=y
BR2_PACKAGE_HOST_GDB_TUI=y
BR2_PACKAGE_HOST_GDB_PYTHON3=y
BR2_PACKAGE_HOST_GDB_SIM=y
BR2_OPTIMIZE_G=y
BR2_TARGET_GENERIC_ROOT_PASSWD="root"
BR2_ENABLE_DEBUG=y
BR2_DEBUG_3=y
BR2_STRIP_strip=n
BR2_PACKAGE_CONNMAN_DEBUG=y
BR2_PACKAGE_STRACE=y
BR2_PACKAGE_LTRACE=y
BR2_PACKAGE_BINUTILS=y
BR2_PACKAGE_BINUTILS_TARGET=y
BR2_PACKAGE_GDB=y
BR2_PACKAGE_GDB_SERVER=y
BR2_PACKAGE_GDB_DEBUGGER=y
BR2_PACKAGE_GDB_TUI=y
BR2_PACKAGE_GDB_PYTHON=y
BR2_PACKAGE_PAX_UTILS=y

# System
BR2_TARGET_GENERIC_HOSTNAME="thinclient"
BR2_TARGET_GENERIC_ISSUE="Welcome to Thinclient"
BR2_ROOTFS_DEVICE_CREATION_DYNAMIC_EUDEV=y
BR2_SYSTEM_ENABLE_NLS=y
BR2_TARGET_TZ_INFO=y
BR2_ENABLE_LOCALE_WHITELIST="C en_US zh_CN"
BR2_GENERATE_LOCALE="en_US.UTF-8 zh_CN.UTF-8"
BR2_ROOTFS_MERGED_USR=y
BR2_ROOTFS_USERS_TABLES="linux-thinclient/board/qemu/users.txt"

# Image
BR2_ROOTFS_POST_BUILD_SCRIPT="linux-thinclient/board/qemu/x86_64/post-build.sh"
BR2_ROOTFS_POST_IMAGE_SCRIPT="linux-thinclient/board/qemu/post-image.sh"
BR2_ROOTFS_POST_SCRIPT_ARGS="$(BR2_DEFCONFIG)"

# addtion file
BR2_ROOTFS_OVERLAY="linux-thinclient/overlay"

# Linux headers same as kernel, a 5.10 series
BR2_PACKAGE_HOST_LINUX_HEADERS_CUSTOM_5_10=y

# Kernel
BR2_LINUX_KERNEL=y
BR2_LINUX_KERNEL_CUSTOM_VERSION=y
BR2_LINUX_KERNEL_CUSTOM_VERSION_VALUE="5.10.7"
BR2_LINUX_KERNEL_USE_CUSTOM_CONFIG=y
BR2_LINUX_KERNEL_CUSTOM_CONFIG_FILE="linux-thinclient/board/qemu/x86_64/linux.config"

# Packages
BR2_PACKAGE_FREERDP=y
BR2_PACKAGE_FREERDP_CLIENT_WL=y
BR2_PACKAGE_CUPS=y
BR2_PACKAGE_FFMPEG=y
BR2_PACKAGE_FFMPEG_GPL=y
BR2_PACKAGE_FFMPEG_NONFREE=y
BR2_PACKAGE_FFMPEG_XCBGRAB=y
BR2_PACKAGE_LIBUSB=y
BR2_PACKAGE_LINUX_PAM=y
BR2_PACKAGE_WESTON=y
BR2_PACKAGE_WESTON_DRM=y
BR2_PACKAGE_WESTON_FBDEV=y
BR2_PACKAGE_WESTON_RDP=y
BR2_PACKAGE_WESTON_DEFAULT_DRM=y
BR2_PACKAGE_WAYLAND_UTILS=y
BR2_PACKAGE_LIBDRI2=y
BR2_PACKAGE_LIBDRM_VMWGFX=y
BR2_PACKAGE_WLROOTS=y
BR2_PACKAGE_WLROOTS_X11=y
BR2_PACKAGE_MESA3D=y
BR2_PACKAGE_MESA3D_OPENGL_EGL=y
BR2_PACKAGE_MESA3D_OPENGL_ES=y
BR2_PACKAGE_MESA3D_OPENGL_GLX=y
BR2_PACKAGE_MESA3D_GALLIUM_DRIVER_SVGA=y
BR2_PACKAGE_MESA3D_GALLIUM_DRIVER_VIRGL=y
BR2_PACKAGE_MESA3D_GALLIUM_DRIVER_SWRAST=y
BR2_PACKAGE_MESA3D_OSMESA_CLASSIC=y
BR2_PACKAGE_XORG7=y
BR2_PACKAGE_LIBEPOXY=y
BR2_PACKAGE_WESTON_XWAYLAND=y
BR2_PACKAGE_DEJAVU=y
BR2_PACKAGE_WQY_ZENHEI=y
BR2_PACKAGE_QT5=y
BR2_PACKAGE_QT5BASE_GUI=y
BR2_PACKAGE_QT5BASE_OPENGL=y
BR2_PACKAGE_QT5BASE_OPENGL_LIB=y
BR2_PACKAGE_QT5BASE_EGLFS=y
BR2_PACKAGE_QT5WAYLAND=y
BR2_PACKAGE_QT5BASE_LINUXFB=y
BR2_PACKAGE_QT5BASE_DEFAULT_QPA="wayland"
BR2_PACKAGE_ALSA_UTILS=y
BR2_PACKAGE_ALSA_UTILS_ALSACONF=y
BR2_PACKAGE_ALSA_UTILS_ALSALOOP=y
BR2_PACKAGE_PYTHON3=y
BR2_PACKAGE_PYTHON3_CODECSCJK=y
BR2_PACKAGE_PYTHON3_CURSES=y
BR2_PACKAGE_NCURSES_WCHAR=y
BR2_PACKAGE_PYTHON3_READLINE=y
BR2_PACKAGE_PYTHON_PYQT5=y
BR2_PACKAGE_CA_CERTIFICATES=y
BR2_PACKAGE_LIBOPENSSL_BIN=y
BR2_PACKAGE_TMUX=y
BR2_PACKAGE_SCREEN=y
BR2_PACKAGE_DIALOG=y
BR2_PACKAGE_CONNMAN=y
BR2_PACKAGE_CONNMAN_IPTABLES=y
BR2_PACKAGE_CONNMAN_ETHERNET=y
BR2_PACKAGE_CONNMAN_WIFI=y
BR2_PACKAGE_CONNMAN_LOOPBACK=y
BR2_PACKAGE_CONNMAN_CLIENT=y

BR2_PACKAGE_HOST_QEMU=y
BR2_PACKAGE_HOST_QEMU_SYSTEM_MODE=y
```

## linux-thinclient/configs/raspberrypi3_64_defconfig
```kconfig
BR2_aarch64=y
BR2_cortex_a53=y
BR2_ARM_FPU_VFPV4=y

# source code
BR2_KERNEL_MIRROR="https://mirrors.ustc.edu.cn/kernel.org/"

# enable ccache
BR2_CCACHE=y
BR2_CCACHE_DIR="$(TOPDIR)/cache/.buildroot-ccache"
BR2_CCACHE_INITIAL_SETUP="-M 50G"

# toolchain
BR2_TOOLCHAIN_BUILDROOT_GLIBC=y
BR2_PIC_PIE=y
BR2_SSP_STRONG=y
BR2_RELRO_FULL=y
BR2_FORTIFY_SOURCE_2=y
BR2_TOOLCHAIN_BUILDROOT_CXX=y
BR2_GCC_ENABLE_LTO=y
# qt5base pass vvv
BR2_BINUTILS_VERSION_2_32_X=y
BR2_GCC_VERSION_8_X=y


# Linux headers same as kernel, a 5.10 series
BR2_PACKAGE_HOST_LINUX_HEADERS_CUSTOM_5_10=y

# DEBUG
BR2_PACKAGE_HOST_GDB=y
BR2_PACKAGE_HOST_GDB_TUI=y
BR2_PACKAGE_HOST_GDB_PYTHON3=y
BR2_PACKAGE_HOST_GDB_SIM=y
BR2_OPTIMIZE_G=y
BR2_TARGET_GENERIC_ROOT_PASSWD="root"
BR2_ENABLE_DEBUG=y
BR2_DEBUG_3=y
BR2_STRIP_strip=n
BR2_PACKAGE_CONNMAN_DEBUG=y
BR2_PACKAGE_STRACE=y
BR2_PACKAGE_LTRACE=y
BR2_PACKAGE_BINUTILS=y
BR2_PACKAGE_BINUTILS_TARGET=y
BR2_PACKAGE_GDB=y
BR2_PACKAGE_GDB_SERVER=y
BR2_PACKAGE_GDB_DEBUGGER=y
BR2_PACKAGE_GDB_TUI=y
BR2_PACKAGE_GDB_PYTHON=y
BR2_PACKAGE_PAX_UTILS=y

# System
BR2_TARGET_GENERIC_HOSTNAME="thinclient"
BR2_TARGET_GENERIC_ISSUE="Welcome to Thinclient"
BR2_ROOTFS_DEVICE_CREATION_DYNAMIC_EUDEV=y
BR2_SYSTEM_ENABLE_NLS=y
BR2_TARGET_TZ_INFO=y
BR2_ENABLE_LOCALE_WHITELIST="C en_US zh_CN"
BR2_GENERATE_LOCALE="en_US.UTF-8 zh_CN.UTF-8"
BR2_ROOTFS_MERGED_USR=y
BR2_ROOTFS_USERS_TABLES="linux-thinclient/board/qemu/users.txt"

# addtion file
BR2_ROOTFS_OVERLAY="linux-thinclient/overlay"

# kernel
BR2_LINUX_KERNEL=y
BR2_LINUX_KERNEL_CUSTOM_TARBALL=y
BR2_LINUX_KERNEL_CUSTOM_TARBALL_LOCATION="$(call github,raspberrypi,linux,967d45b29ca2902f031b867809d72e3b3d623e7a)/linux-967d45b29ca2902f031b867809d72e3b3d623e7a.tar.gz"
BR2_LINUX_KERNEL_DEFCONFIG="bcmrpi3"

# Build the DTB from the kernel sources
BR2_LINUX_KERNEL_DTS_SUPPORT=y
BR2_LINUX_KERNEL_INTREE_DTS_NAME="broadcom/bcm2710-rpi-3-b broadcom/bcm2710-rpi-3-b-plus broadcom/bcm2837-rpi-3-b"

BR2_LINUX_KERNEL_NEEDS_HOST_OPENSSL=y

# Packages
BR2_PACKAGE_FREERDP=y
BR2_PACKAGE_FREERDP_CLIENT_WL=y
BR2_PACKAGE_CUPS=y
BR2_PACKAGE_FFMPEG=y
BR2_PACKAGE_FFMPEG_GPL=y
BR2_PACKAGE_FFMPEG_NONFREE=y
BR2_PACKAGE_FFMPEG_XCBGRAB=y
BR2_PACKAGE_LIBUSB=y
BR2_PACKAGE_LINUX_PAM=y
BR2_PACKAGE_WESTON=y
BR2_PACKAGE_WESTON_DRM=y
BR2_PACKAGE_WESTON_FBDEV=y
BR2_PACKAGE_WESTON_RDP=y
BR2_PACKAGE_WESTON_DEFAULT_DRM=y
BR2_PACKAGE_WAYLAND_UTILS=y
BR2_PACKAGE_LIBDRI2=y
BR2_PACKAGE_WLROOTS=y
BR2_PACKAGE_WLROOTS_X11=y
BR2_PACKAGE_MESA3D=y
BR2_PACKAGE_MESA3D_OPENGL_EGL=y
BR2_PACKAGE_MESA3D_OPENGL_ES=y
BR2_PACKAGE_MESA3D_OPENGL_GLX=y
BR2_PACKAGE_MESA3D_OSMESA_CLASSIC=y
BR2_PACKAGE_MESA3D_GALLIUM_DRIVER_VC4=y
BR2_PACKAGE_MESA3D_GALLIUM_DRIVER_SWRAST=y
BR2_PACKAGE_MESA3D_GALLIUM_DRIVER_KMSRO=y
BR2_PACKAGE_LIBDRM_VC4=y
BR2_PACKAGE_XORG7=y
BR2_PACKAGE_LIBEPOXY=y
BR2_PACKAGE_WESTON_XWAYLAND=y
BR2_PACKAGE_DEJAVU=y
BR2_PACKAGE_WQY_ZENHEI=y
BR2_PACKAGE_QT5=y
BR2_PACKAGE_QT5BASE_GUI=y
BR2_PACKAGE_QT5BASE_OPENGL=y
BR2_PACKAGE_QT5BASE_OPENGL_LIB=y
BR2_PACKAGE_QT5BASE_EGLFS=y
BR2_PACKAGE_QT5WAYLAND=y
BR2_PACKAGE_QT5BASE_OPENGL_ES2=y
BR2_PACKAGE_QT5BASE_DEFAULT_QPA="wayland"
BR2_PACKAGE_ALSA_UTILS=y
BR2_PACKAGE_ALSA_UTILS_ALSACONF=y
BR2_PACKAGE_ALSA_UTILS_ALSALOOP=y
BR2_PACKAGE_PYTHON3=y
BR2_PACKAGE_PYTHON3_CODECSCJK=y
BR2_PACKAGE_PYTHON3_CURSES=y
BR2_PACKAGE_NCURSES_WCHAR=y
BR2_PACKAGE_PYTHON3_READLINE=y
BR2_PACKAGE_PYTHON_PYQT5=y
BR2_PACKAGE_CA_CERTIFICATES=y
BR2_PACKAGE_LIBOPENSSL_BIN=y
BR2_PACKAGE_TMUX=y
BR2_PACKAGE_SCREEN=y
BR2_PACKAGE_DIALOG=y
BR2_PACKAGE_CONNMAN=y
BR2_PACKAGE_CONNMAN_IPTABLES=y
BR2_PACKAGE_CONNMAN_ETHERNET=y
BR2_PACKAGE_CONNMAN_WIFI=y
BR2_PACKAGE_CONNMAN_LOOPBACK=y
BR2_PACKAGE_CONNMAN_CLIENT=y

# Firmware
BR2_PACKAGE_RPI_WIFI_FIRMWARE=y

# RPI bootloader
BR2_PACKAGE_RPI_FIRMWARE=y
BR2_PACKAGE_RPI_FIRMWARE_X=y

# Required tools to create the SD image
BR2_PACKAGE_HOST_DOSFSTOOLS=y
BR2_PACKAGE_HOST_GENIMAGE=y
BR2_PACKAGE_HOST_MTOOLS=y

# Filesystem / image
BR2_TARGET_ROOTFS_EXT2_4=y
BR2_TARGET_ROOTFS_EXT2=y
BR2_TARGET_ROOTFS_EXT2_SIZE="4096M"
BR2_TARGET_ROOTFS_EXT2_MKFS_OPTIONS=""
# BR2_TARGET_ROOTFS_TAR is not set
BR2_ROOTFS_POST_BUILD_SCRIPT="board/raspberrypi3-64/post-build.sh"
BR2_ROOTFS_POST_IMAGE_SCRIPT="board/raspberrypi3-64/post-image.sh"
BR2_ROOTFS_POST_SCRIPT_ARGS="--aarch64 --add-miniuart-bt-overlay"
```

## package/tigervnc/Config.in
```kconfig
config BR2_PACKAGE_TIGERVNC
	bool "tigervnc"
	select BR2_PACKAGE_FLTK
	select BR2_PACKAGE_GNUTLS
	select BR2_PACKAGE_ZLIB
	select BR2_BR2_PACKAGE_XLIB_LIBX11
	select BR2_BR2_PACKAGE_XLIB_LIBXEXT
	select BR2_BR2_PACKAGE_XLIB_LIBXTST
	select BR2_BR2_PACKAGE_XLIB_LIBXRANDR
	select BR2_BR2_PACKAGE_XLIB_LIBXDAMAGE
	select BR2_BR2_PACKAGE_PIXMAN
	help
	  TigerVNC is a free implementaion of the VNC
```

## rpizerow-toolbox/configs/qemu_arm1176jzf-s_defconfig
```kconfig
# arch
BR2_arm=y
BR2_arm1176jzf_s=y
BR2_ARM_EABIHF=y

# download dir
BR2_DL_DIR="/buildroot-dl"

# ccache
BR2_CCACHE=y
BR2_CCACHE_DIR="/buildroot-ccache"

# musl libc
BR2_TOOLCHAIN_BUILDROOT_MUSL=y

# no init
# add switch_root scripts later
BR2_INIT_NONE=y

# linux kernel
BR2_LINUX_KERNEL=y
```
